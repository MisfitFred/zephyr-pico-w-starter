## components/component_a/tests/testcase.yaml
```yaml
tests:
  components.component_a:
    tags: component_a
    platform_allow: native_sim native_sim/native/64
    timeout: 60
```

## components/component_b/tests/testcase.yaml
```yaml
tests:
  components.component_b:
    tags: component_b
    platform_allow: native_sim native_sim/native/64
    timeout: 60
```

## components/component_template/tests/testcase.yaml
```yaml
tests:
  components.__COMPONENT_NAME__:
    tags: __COMPONENT_NAME__
    platform_allow:
      - native_sim
      - native_sim/native/64
    timeout: 60
```

## components/main/tests/testcase.yaml
```yaml
tests:
  components.main:
    tags: main
    platform_allow:
      - native_sim
      - native_sim/native/64
    timeout: 60
```
